## main/Kconfig.projbuild
```kconfig
menu "Example Configuration"

config WIFI_SSID
    string "WiFi SSID"
    default "myssid"
    help
        SSID (network name) for the example to connect to.

config WIFI_PASSWORD
    string "WiFi Password"
    default "mypassword"
    help
        WiFi password (WPA or WPA2) for the example to use.

config BROKER_URL
    string "Broker URL"
    default "mqtt://iot.eclipse.org"
    help
        URL of the broker to connect to

config MQTT_USERNAME
    string "MQTT Username"
    default "admin"
    help
        MQTT username for the example to use.

config MQTT_PASSWORD
    string "MQTT Password"
    default "admin"
    help
        MQTT password for the example to use.

config BROKER_URL_FROM_STDIN
    bool
    default y if BROKER_URL = "FROM_STDIN"

config ONE_WIRE_GPIO
    int "OneWire GPIO number"
	range 0 34
	default 27
	help
		GPIO number (IOxx) to access One Wire Bus.

		Some GPIOs are used for other purposes (flash connections, etc.) and cannot be used.

		GPIOs 35-39 are input-only so cannot be used to drive the One Wire Bus.

endmenu
```
